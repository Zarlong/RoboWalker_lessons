/*****************************************************************
Датчик APDS-9960 для определения жестов, цвета RGB, приближения и яркости света
http://iarduino.ru/shop/Sensory-Datchiki/datchik-zhestov-osveschennosti-i-cveta-apds-9960.html
Данный скетч определяет яркость света и яркость каждого канала RGB
******************************************************************

ПОДКЛЮЧЕНИЕ ДАТЧИКА:

 Arduino | APDS-9960 | Назначение вывода
 --------+-----------+---------------------------------
   3.3V  |  VCC      | Напряжение питания
 --------+-----------+---------------------------------
   GND   |  GND      | Земля
 --------+-----------+---------------------------------
    A4   |  SDA      | Линия данных шины I2C
 --------+-----------+---------------------------------
    A5   |  SCL      | Линия тактирования шины I2C 
 --------+-----------+---------------------------------
         |  INT      | Выход прерывания (активный уровень «0»)
         |           | Вывод не используется в данном скетче

ВАЖНО: У датчика APDS-9960 логика и питание только 3,3 В
*****************************************************************/

// Подключаем библиотеки:                                       //
#include <Wire.h>                                               // Для работы с шиной I2C
#include <SparkFun_APDS9960.h>                                  // Для работы с датчиком APDS-9960
SparkFun_APDS9960 apds = SparkFun_APDS9960();                   // Определяем объект apds, экземпляр класса SparkFun_APDS9960
                                                                //
// Объявляем переменные:                                        //
uint16_t lightAmbient = 0;                                      // Определяем переменную для хранения освещённости общей            в люксах
uint16_t lightRed     = 0;                                      // Определяем переменную для хранения освещённости красного спектра в люксах
uint16_t lightGreen   = 0;                                      // Определяем переменную для хранения освещённости зелёного спектра в люксах
uint16_t lightBlue    = 0;                                      // Определяем переменную для хранения освещённости синего   спектра в люксах
                                                                //
void setup(){                                                   //
    Serial.begin(9600);                                         // Инициируем передачу данных в монитор последовательного порта на скорости 9600 бит/сек
//  Инициируем работу датчика:                                  // 
    if(apds.init()){                                            // Если инициализация прошла успешно, то ...
          Serial.println("Initialization OK!");                 // Выводим сообщение об успешной инициализации датчика
    }else{Serial.println("Initialization ERROR!");}             // Иначе, выводим сообщение об ошибке инициализации датчика
                                                                //
//  Разрешаем режим определения освещённости:                   //
    if(apds.enableLightSensor(false)){                          // Если режим определения освещённости запущен (false - без прерываний на выходе INT), то ...
          Serial.println("Start light sensor OK!");             // Выводим сообщение об успешном запуске режима определения освещённости
    }else{Serial.println("Start light sensor ERROR!");}         // Иначе, выводим сообщение об ошибке запуска режима определения освещённости
                                                                // Запретить режим определения освещённости можно так: bool j = apds.disableLightSensor(); // в переменную j сохранится результат выполнения функции (true/false)
//  Ждём завершение инициализации и калибровки:                 //
    delay(500);                                                 //
}                                                               //
                                                                //
void loop(){                                                    //
//  Читаем значения освещённости в переменные:                  //
    if(apds.readAmbientLight (lightAmbient)                     // Если прочитано значение общей освещённости
    && apds.readRedLight     (lightRed)                         // И    прочитано значение освещённости красного спектра
    && apds.readGreenLight   (lightGreen)                       // И    прочитано значение освещённости зелёного спектра
    && apds.readBlueLight    (lightBlue)   ){                   // И    прочитано значение освещённости синего   спектра, то ...
          Serial.println((String) "Ambient=" + lightAmbient + ", Red=" + lightRed + ", Green=" + lightGreen + ", Blue=" + lightBlue + " lx"); // Выводим все прочитанные значения
    }else{Serial.println("Read light ERROR!");}                 // Иначе, выводим сообщение об ошибке чтения освещённости
                                                                //
//  Приостанавливаем выполнение скетча на 1 секунду:            //
    delay(1000);                                                // Чтоб не перегружать шину I2C постоянными запросами
}                                                               //
